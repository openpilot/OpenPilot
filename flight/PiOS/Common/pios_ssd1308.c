/**
 ******************************************************************************
 * @addtogroup PIOS PIOS Core hardware abstraction layer
 * @{
 * @addtogroup PIOS_SSD1308 SSD1308 Functions
 * @brief Deals with the hardware interface to the display
 * @{
 * @file       pios_ssd1308.c
 * @author     The OpenPilot Team, http://www.openpilot.org Copyright (C) 2012.
 * @brief      SSD1308 Magnetic Sensor Functions from AHRS
 * @see        The GNU Public License (GPL) Version 3
 *
 ******************************************************************************
 */
/* 
 * This program is free software; you can redistribute it and/or modify 
 * it under the terms of the GNU General Public License as published by 
 * the Free Software Foundation; either version 3 of the License, or 
 * (at your option) any later version.
 * 
 * This program is distributed in the hope that it will be useful, but 
 * WITHOUT ANY WARRANTY; without even the implied warranty of MERCHANTABILITY 
 * or FITNESS FOR A PARTICULAR PURPOSE. See the GNU General Public License 
 * for more details.
 * 
 * You should have received a copy of the GNU General Public License along 
 * with this program; if not, write to the Free Software Foundation, Inc., 
 * 59 Temple Place, Suite 330, Boston, MA 02111-1307 USA
 */

/* Project Includes */
#include "pios.h"

#if defined(PIOS_INCLUDE_SSD1308)

/* Global Variables */
#define FONT_WIDTH 6
#define FONT_HEIGHT 8

const uint8_t BasicFont6[][6]={
{0x00,0x00,0x00,0x00,0x00,0x00}, // space
// 00000000
// 00000000
// 01011111
// 00000000
// 00000000
// 00000000
{0x00,0x00,0x5F,0x00,0x00,0x00}, // !
// 00000000
// 00000000
// 00000111
// 00000000
// 00000111
// 00000000
{0x00,0x00,0x07,0x00,0x07,0x00}, // "
// 00000000
// 00010100
// 01111111
// 00010100
// 01111111
// 00010100
{0x00,0x14,0x7F,0x14,0x7F,0x14}, // #
// 00000000
// 00100100
// 00101010
// 01111111
// 00101010
// 00010010
{0x00,0x24,0x2A,0x7F,0x2A,0x12}, // $
{0x00,0x23,0x13,0x08,0x64,0x62},
{0x00,0x36,0x49,0x55,0x22,0x50},
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{0x00,0x02,0x05,0x05,0x02,0x00}
};

static const uint8_t BasicFont8[][8]=
{
  {0x00,0x00,0x00,0x00,0x00,0x00,0x00,0x00},
  {0x00,0x00,0x5F,0x00,0x00,0x00,0x00,0x00},
  {0x00,0x00,0x07,0x00,0x07,0x00,0x00,0x00},
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  {0x00,0x02,0x05,0x05,0x02,0x00,0x00,0x00}
};

static uint8_t FrameBuffer[1024];

#define DISPLAY_WIDTH 128
#define DISPLAY_HEIGHT 64

/* Local Types */

/* Local Variables */

static int32_t PIOS_SSD1308_Read(uint8_t address, uint8_t * buffer, uint8_t len);
static int32_t PIOS_SSD1308_Write(uint8_t address, uint8_t buffer);

//static const struct pios_ssd1308_cfg * dev_cfg;

/**
 * @brief Initialize the SSD1308 display
 * @return none
 */
int8_t PIOS_SSD1308_Init(void)
{
	PIOS_SSD1308_Write(PIOS_SSD1308_Command_Mode, PIOS_SSD1308_Display_Off_Cmd);//display off
	PIOS_DELAY_WaitmS(10);
	PIOS_SSD1308_Write(PIOS_SSD1308_Command_Mode, PIOS_SSD1308_Display_On_Cmd);//display on
	PIOS_DELAY_WaitmS(10);
	PIOS_SSD1308_Write(PIOS_SSD1308_Command_Mode, PIOS_SSD1308_Normal_Display_Cmd);//Set Normal Display (default)

	return 0;
}

void PIOS_SSD1308_setBrightness(uint8_t Brightness)
{
	PIOS_SSD1308_Write(PIOS_SSD1308_Command_Mode, PIOS_SSD1308_Set_Brightness_Cmd);
	PIOS_SSD1308_Write(PIOS_SSD1308_Command_Mode, Brightness);
}

void PIOS_SSD1308_setHorizontalMode()
{
	PIOS_SSD1308_Write(PIOS_SSD1308_Command_Mode, PIOS_SSD1308_Set_Paging_Cmd);
	PIOS_SSD1308_Write(PIOS_SSD1308_Command_Mode, PIOS_SSD1308_Paging_Horizontal);
    //addressingMode = HORIZONTAL_MODE;
}

void PIOS_SSD1308_setPageMode()
{
    //addressingMode = PAGE_MODE;
    PIOS_SSD1308_Write(PIOS_SSD1308_Command_Mode, PIOS_SSD1308_Set_Paging_Cmd);
    PIOS_SSD1308_Write(PIOS_SSD1308_Command_Mode, PIOS_SSD1308_Paging_Vertical);
}

void PIOS_SSD1308_setPageAddress(uint8_t start, uint8_t end)
{
PIOS_SSD1308_Write(PIOS_SSD1308_Command_Mode, PIOS_SSD1308_SET_PAGE_ADDRESS);
PIOS_SSD1308_Write(PIOS_SSD1308_Command_Mode, start);
PIOS_SSD1308_Write(PIOS_SSD1308_Command_Mode, end);
}
void PIOS_SSD1308_setColumnAddress(uint8_t start, uint8_t end)
{
PIOS_SSD1308_Write(PIOS_SSD1308_Command_Mode, PIOS_SSD1308_SET_COLUMN_ADDRESS);
PIOS_SSD1308_Write(PIOS_SSD1308_Command_Mode, start);
PIOS_SSD1308_Write(PIOS_SSD1308_Command_Mode, end);
}

void PIOS_SSD1308_setTextXY(uint8_t Row, uint8_t Column)
{
	PIOS_SSD1308_setPageAddress(0,7);
	PIOS_SSD1308_setColumnAddress(0,127);
	//PIOS_SSD1308_Write(PIOS_SSD1308_Command_Mode, 0xB0 + Row);//set page address
	//PIOS_SSD1308_Write(PIOS_SSD1308_Command_Mode, 0x00 + (8*Column & 0x0F));//set column lower address
	//PIOS_SSD1308_Write(PIOS_SSD1308_Command_Mode, ((8*Column>>4)&0x0F));//set column higher address
}

void PIOS_SSD1308_putChar(uint8_t C)
{
    if(C < 32 || C > 127) //Ignore non-printable ASCII characters. This can be modified for multilingual font.
    {
    C=' '; //Space
    }
    uint8_t i=0;
    for(i=0;i<8;i++)
    {
       //read bytes from code memory
    	PIOS_SSD1308_Write(PIOS_SSD1308_Data_Mode, BasicFont8[C-32][i]);//font array starts at 0, ASCII starts at 32. Hence the translation
    }
}

void PIOS_SSD1308_putString(const uint8_t *String)
{
    uint8_t i=0;
    while(String[i])
    {
        PIOS_SSD1308_putChar(String[i]);     
        i++;
    }
}

void PIOS_SSD1308_clearDisplay()
{
  unsigned char i,j;
  for(j=0;j<8;j++)
  {
    PIOS_SSD1308_setTextXY(j,0);
    {
      for(i=0;i<128;i++)  //clear all columns
      {
        PIOS_SSD1308_putChar(' ');
      }
    }
  }
  PIOS_SSD1308_setTextXY(0,0);
}


//-------------------------------------------------Graphical functions----------------------------
// reset framebuffer
void PIOS_SSD1308_ClearFrameBuffer() {
  uint16_t i;
  for(i = 0; i < 1024; ++i) {
    FrameBuffer[i] = 0;
  }
}

// show framebuffer
void PIOS_SSD1308_ShowFrameBuffer() {
  uint16_t i;
  for (i = 0; i < 1024; ++i) {
  PIOS_SSD1308_Write(PIOS_SSD1308_Data_Mode, FrameBuffer[i]);
  }
}

// draw a single pixel
void PIOS_SSD1308_drawPixel(uint8_t on, uint8_t x, uint8_t y) {
  if(on) { // color (normal, inverted)
    FrameBuffer[((y & ~7) << 4) + x] |= 1 << (y & 7);
  } else {
    FrameBuffer[((y & ~7) << 4) + x] &= ~(1 << (y & 7));
  }
}

// returns the color of a pixel
uint8_t PIOS_SSD1308_getPixel(uint8_t x, uint8_t y) {
  return (FrameBuffer[((y & ~7) << 4) + x] & (1 << (y & 7))) != 0;
}

// draw a line with Bresenham line-drawing algorithm (Source: Wikipedia)
void PIOS_SSD1308_drawLine(uint8_t on, int x0, int y0, int x1, int y1) {
  int dx = abs(x1 - x0), sx = x0 < x1 ? 1 : -1;
  int dy = -abs(y1 - y0), sy = y0 < y1 ? 1 : -1;
  int err = dx + dy, e2;
  
  for(;;) {
    PIOS_SSD1308_drawPixel(on, x0, y0);
    if(x0 == x1 && y0 == y1) break;
    e2 = 2 * err;
    if(e2 > dy) { err += dy; x0 += sx; }
    if(e2 < dx) { err += dx; y0 += sy; }
  }
}

// draw a rectangle
void PIOS_SSD1308_drawRectangle(uint8_t on, int x0, int y0, int x1, int y1) {
  PIOS_SSD1308_drawLine(on, x0, y0, x1, y0);
  PIOS_SSD1308_drawLine(on, x1, y0, x1, y1);
  PIOS_SSD1308_drawLine(on, x1, y1, x0, y1);
  PIOS_SSD1308_drawLine(on, x0, y1, x0, y0);
}

// draw a filled rectangle
void PIOS_SSD1308_drawFullRectangle(uint8_t on, int x0, int y0, int x1, int y1) {
  uint8_t i;
  for(i = y0; i <= y1; i++) {
    PIOS_SSD1308_drawLine(on, x0, i, x1, i);
  }
}

// draw a circle with Bresenham circle-drawing algorithm (Source: Wikipedia)
void PIOS_SSD1308_drawCircle(uint8_t on, int x0, int y0, int radius) {
  int f = 1 - radius;
  int ddF_x = 0;
  int ddF_y = -2 * radius;
  int x = 0;
  int y = radius;

  PIOS_SSD1308_drawPixel(on, x0, y0 + radius);
  PIOS_SSD1308_drawPixel(on, x0, y0 - radius);
  PIOS_SSD1308_drawPixel(on, x0 + radius, y0);
  PIOS_SSD1308_drawPixel(on, x0 - radius, y0);

  while(x < y) {
    if(f >= 0) {
      y--;
      ddF_y += 2;
      f += ddF_y;
    }
    x++;
    ddF_x += 2;
    f += ddF_x + 1;

    PIOS_SSD1308_drawPixel(on, x0 + x, y0 + y);
    PIOS_SSD1308_drawPixel(on, x0 - x, y0 + y);
    PIOS_SSD1308_drawPixel(on, x0 + x, y0 - y);
    PIOS_SSD1308_drawPixel(on, x0 - x, y0 - y);
    PIOS_SSD1308_drawPixel(on, x0 + y, y0 + x);
    PIOS_SSD1308_drawPixel(on, x0 - y, y0 + x);
    PIOS_SSD1308_drawPixel(on, x0 + y, y0 - x);
    PIOS_SSD1308_drawPixel(on, x0 - y, y0 - x);
  }
}

// draw a filled circle with Bresenham circle-drawing algorithm (Source: Wikipedia)
void PIOS_SSD1308_drawFullCircle(uint8_t on, int x0, int y0, int radius) {
  int f = 1 - radius;
  int ddF_x = 0;
  int ddF_y = -2 * radius;
  int x = 0;
  int y = radius;

  PIOS_SSD1308_drawLine(on, x0, y0 + radius, x0, y0 - radius);
  PIOS_SSD1308_drawLine(on, x0 + radius, y0, x0 - radius, y0);

  while(x < y) {
    if(f >= 0) {
      y--;
      ddF_y += 2;
      f += ddF_y;
    }
    x++;
    ddF_x += 2;
    f += ddF_x + 1;

    PIOS_SSD1308_drawLine(on, x0 + x, y0 + y, x0 - x, y0 + y);
    PIOS_SSD1308_drawLine(on, x0 + x, y0 - y, x0 - x, y0 - y);
    PIOS_SSD1308_drawLine(on, x0 + y, y0 + x, x0 - y, y0 + x);
    PIOS_SSD1308_drawLine(on, x0 + y, y0 - x, x0 - y, y0 - x);
  }
}

// draw a ellipse with Bresenham ellipse-drawing algorithm (Source: Wikipedia)
void PIOS_SSD1308_drawEllipse(uint8_t on, int x0, int y0, int a, int b) {
  int dx = 0, dy = b;
  long a2 = a * a, b2 = b * b;
  long err = b2-(2 * b - 1) * a2, e2;

  do {
    PIOS_SSD1308_drawPixel(on, x0 + dx, y0 + dy);
    PIOS_SSD1308_drawPixel(on, x0 - dx, y0 + dy);
    PIOS_SSD1308_drawPixel(on, x0 - dx, y0 - dy);
    PIOS_SSD1308_drawPixel(on, x0 + dx, y0 - dy);

    e2 = 2 * err;
    if(e2 < (2 * dx + 1) * b2) { dx++; err += (2 * dx + 1) * b2; }
    if(e2 > -(2 * dy - 1) * a2) { dy--; err -= (2 * dy - 1) * a2; }
  } while(dy >= 0);

  while(dx++ < a) {
    PIOS_SSD1308_drawPixel(on, x0 + dx, y0);
    PIOS_SSD1308_drawPixel(on, x0 - dx, y0);
  }
}

// draw a ellipse with Bresenham ellipse-drawing algorithm (Source: Wikipedia)
void PIOS_SSD1308_drawFullEllipse(uint8_t on, int x0, int y0, int a, int b) {
  int dx = 0, dy = b;
  long a2 = a * a, b2 = b * b;
  long err = b2-(2 * b - 1) * a2, e2;

  do {
    PIOS_SSD1308_drawLine(on, x0 + dx, y0 + dy, x0 - dx, y0 + dy);
    PIOS_SSD1308_drawLine(on, x0 - dx, y0 - dy, x0 + dx, y0 - dy);

    e2 = 2 * err;
    if(e2 < (2 * dx + 1) * b2) { dx++; err += (2 * dx + 1) * b2; }
    if(e2 > -(2 * dy - 1) * a2) { dy--; err -= (2 * dy - 1) * a2; }
  } while(dy >= 0);

  while(dx++ < a) {
    PIOS_SSD1308_drawLine(on, x0 + dx, y0, x0 - dx, y0);
  }
}

void PIOS_SSD1308_Float2String(uint8_t * text, float fl, uint8_t textlen, uint8_t nbafter)
{
	bool sens=0;
	float Tempfl;
	float deci=0.0f;
	uint16_t before;
	uint16_t after;
	if(fl>=0.0f)
	{
		sens=1;
		Tempfl=fl;
	}
	else
	{
		sens=0;
		Tempfl=-fl;
	}
	for(uint8_t i=0;i<textlen;i++)
	{
		deci=(float)(i+1)*10;
	}
}

/*void ssprintf(float Value)
{
	float nb;
	unsigned char i;
	if(Value<0.0)
	{
		USB_Out_Buffer[NextUSBOut] ='-';
		Value=-Value;
		++NextUSBOut;
	}
	for(i=0;i<=10;i++)
	{
		nb=100.0*i;
		if(nb>Value)
		{
			USB_Out_Buffer[NextUSBOut] =tablechar[i-1];
			++NextUSBOut;
			Value-=100.0*(i-1);
			break;
		}
	}	
	for(i=0;i<=10;i++)
	{
		nb=10.0*i;
		if(nb>Value)
		{
			USB_Out_Buffer[NextUSBOut] =tablechar[i-1];
			++NextUSBOut;
			Value-=10.0*(i-1);
			break;
		}
	}	
	for(i=0;i<=10;i++)
	{
		nb=(float)i;
		if(nb>Value)
		{
			USB_Out_Buffer[NextUSBOut] =tablechar[i-1];
			++NextUSBOut;
			Value-=(float)(i-1);
			break;
		}
	}
	USB_Out_Buffer[NextUSBOut] ='.';
	++NextUSBOut;
	for(i=0;i<=10;i++)
	{
		nb=0.1*i;
		if(nb>Value)
		{
			USB_Out_Buffer[NextUSBOut] =tablechar[i-1];
			++NextUSBOut;
			Value-=0.1*(i-1);
			break;
		}
	}	
	for(i=0;i<=10;i++)
	{
		nb=0.01*i;
		if(nb>Value)
		{
			USB_Out_Buffer[NextUSBOut] =tablechar[i-1];
			++NextUSBOut;
			Value-=0.01*(i-1);
			break;
		}
	}		*/

// draw text
void PIOS_SSD1308_drawText(uint8_t on, uint8_t x0, uint8_t y0, uint8_t * text, uint8_t size, uint8_t clear) {
  uint8_t x = x0;
  uint8_t i = 0;
  while(i < size) {
    if(((x + FONT_WIDTH) >= DISPLAY_WIDTH) || x0 < 0) break; // font out of display x
    if(((y0 + FONT_HEIGHT) >= DISPLAY_HEIGHT) || y0 < 0) break; // font out of display y
    uint8_t chr = text[i++] - 32;
    for(int j = 0; j < FONT_WIDTH; j++) {
      uint8_t chr_font = BasicFont6[chr][j];
      uint8_t bytepos = 1;
      for(int k = 0; k < FONT_HEIGHT; k++) {
        uint8_t pixel = bytepos & chr_font;
        if(pixel > 0) {
          pixel = 1;
        } else {
          pixel = 0;
        }
        PIOS_SSD1308_drawPixel(pixel,x + j,y0 + k);
        bytepos = bytepos * 2;
      }
    }
    x += FONT_WIDTH;
  }
}

//------------------------------------------------------------------------------------------------

/**
 * @brief Reads one or more bytes into a buffer
 * \param[in] address SSD1308 register address (depends on size)
 * \param[out] buffer destination buffer
 * \param[in] len number of bytes which should be read
 * \return 0 if operation was successful
 * \return -1 if error during I2C transfer
 * \return -2 if unable to claim i2c device
 */
static int32_t PIOS_SSD1308_Read(uint8_t address, uint8_t * buffer, uint8_t len)
{
	uint8_t addr_buffer[] = {
		address,
	};
	
	const struct pios_i2c_txn txn_list[] = {
		{
			.info = __func__,
			.addr = PIOS_SSD1308_I2C_ADDR,
			.rw = PIOS_I2C_TXN_WRITE,
			.len = sizeof(addr_buffer),
			.buf = addr_buffer,
		}
		,
		{
			.info = __func__,
			.addr = PIOS_SSD1308_I2C_ADDR,
			.rw = PIOS_I2C_TXN_READ,
			.len = len,
			.buf = buffer,
		}
	};
	
	return PIOS_I2C_Transfer(PIOS_I2C_SSD1308_ADAPTER, txn_list, NELEMENTS(txn_list));
}

/**
 * @brief Writes one or more bytes to the SSD1308
 * \param[in] address Register address
 * \param[in] buffer source buffer
 * \return 0 if operation was successful
 * \return -1 if error during I2C transfer
 * \return -2 if unable to claim i2c device
 */
static int32_t PIOS_SSD1308_Write(uint8_t address, uint8_t buffer)
{
	uint8_t data[] = {
		address,
		buffer,
	};
	
	const struct pios_i2c_txn txn_list[] = {
		{
			.info = __func__,
			.addr = PIOS_SSD1308_I2C_ADDR,
			.rw = PIOS_I2C_TXN_WRITE,
			.len = sizeof(data),
			.buf = data,
		}
		,
	};
	;
	return PIOS_I2C_Transfer(PIOS_I2C_SSD1308_ADAPTER, txn_list, NELEMENTS(txn_list));
}


#endif /* PIOS_INCLUDE_SSD1308 */

/**
 * @}
 * @}
 */
